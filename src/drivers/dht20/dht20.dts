/dts-v1/;
/plugin/;

/ {
    compatible = "brcm,bcm2711", "brcm,bcm2708";

    fragment@0 {
        target = <&i2c1>;
        __overlay__ {
            status = "okay";

            dht20@38 {
                compatible = "asair,dht20";
                reg = <0x38>;
            };
        };
    };
};